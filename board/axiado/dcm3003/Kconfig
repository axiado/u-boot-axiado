## board/axiado/dcm3003/Kconfig
```kconfig
# SPDX-License-Identifier: GPL-2.0+
#
#Copyright (c) 2021-25 Axiado Corporation (or its affiliates).
#

if TARGET_AX3000_EVK

config SYS_BOARD
	string
	default "dcm3003"

config SYS_VENDOR
	string
	default "axiado"

config SYS_CONFIG_NAME
	string
	default "ax3000-evk"

config SYS_INIT_SP_BSS_OFFSET
	default 524288

config AXIADO_VERIFY_FIT
	bool "Support for Axiado FIT verification"
	default y

config AXIADO_FAILOVER
	bool "Support for Axiado failover mechanism"
	default y

endif
```

## configs/ax3000_evk_defconfig
```kconfig
# SPDX-License-Identifier: GPL-2.0+
#
# Copyright (c) 2021-25 Axiado Corporation (or its affiliates).

CONFIG_ARM=y
CONFIG_POSITION_INDEPENDENT=y
CONFIG_GIC_V3_ITS=y
CONFIG_SYS_TEXT_BASE=0x3C000000
CONFIG_SYS_MALLOC_F_LEN=0x8000
CONFIG_ENV_SIZE=0x10000
CONFIG_ENV_OFFSET=0x5000
CONFIG_NR_DRAM_BANKS=3
CONFIG_ARMV8_MULTIENTRY=y
CONFIG_ARMV8_SET_SMPEN=y
CONFIG_ARMV8_SPIN_TABLE=y
CONFIG_SYS_CUSTOM_LDSCRIPT=y
CONFIG_SYS_LDSCRIPT="arch/arm/cpu/armv8/u-boot.lds"
CONFIG_FIT=y
# CONFIG_LEGACY_IMAGE_FORMAT is not set
CONFIG_OF_BOARD_SETUP=y
CONFIG_USE_PREBOOT=y
CONFIG_SYS_CONSOLE_IS_IN_ENV=y
CONFIG_DEFAULT_FDT_FILE="ax3000-evk.dtb"
CONFIG_MISC_INIT_R=y
# CONFIG_DISPLAY_CPUINFO is not set
CONFIG_HUSH_PARSER=y
CONFIG_SYS_PROMPT="U-Boot> "
CONFIG_AUTOBOOT_KEYED=y
CONFIG_AUTOBOOT_PROMPT="Press \"<Esc><Esc>\" to stop autobooting in %d seconds\n"
CONFIG_AUTOBOOT_STOP_STR="\x1b\x1b"
# CONFIG_CMD_BOOTEFI is not set
# CONFIG_CMD_ELF is not set
# CONFIG_CMD_GO is not set
CONFIG_CMD_NVEDIT_EFI=y
CONFIG_CMD_MEMTEST=y
CONFIG_SYS_ALT_MEMTEST=y
CONFIG_CMD_CLK=y
CONFIG_CMD_DFU=y
CONFIG_CMD_DM=y
CONFIG_CMD_GPT=y
CONFIG_CMD_GPT_RENAME=y
CONFIG_CMD_MMC=y
CONFIG_CMD_PART=y
CONFIG_CMD_TFTPPUT=y
CONFIG_CMD_CACHE=y
CONFIG_CMD_EXT2=y
CONFIG_CMD_EXT4=y
CONFIG_CMD_EXT4_WRITE=y
CONFIG_CMD_FAT=y
CONFIG_CMD_FS_GENERIC=y
CONFIG_OF_CONTROL=y
CONFIG_OF_EMBED=y
CONFIG_DEFAULT_DEVICE_TREE="ax3000-evk"
CONFIG_MULTI_DTB_FIT=y
CONFIG_ENV_IS_IN_MMC=y
CONFIG_DM_MMC=y
CONFIG_SUPPORT_EMMC_BOOT=y
CONFIG_MMC_IO_VOLTAGE=y
CONFIG_MMC_UHS_SUPPORT=y
CONFIG_MMC_HS400_SUPPORT=y
CONFIG_MMC_SDHCI=y
CONFIG_MMC_SDHCI_SDMA=y
CONFIG_MMC_SDHCI_AXIADO=y
CONFIG_PHY=y
CONFIG_PHY_AXIADO_EMMC=y
CONFIG_DISPLAY=y
CONFIG_TARGET_AX3000_EVK=y
CONFIG_CLK=y
# CONFIG_AUTO_COMPLETE is not set
# CONFIG_SYS_LONGHELP is not set
```
